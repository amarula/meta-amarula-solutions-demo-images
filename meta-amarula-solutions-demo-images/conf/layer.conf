## meta-amarula-solutions-demo-images/conf/layer.conf
```bitbake
# We have a conf and classes directory, add to BBPATH
BBPATH .= ":${LAYERDIR}"

# We have recipes-* directories, add to BBFILES
BBFILES += "${LAYERDIR}/recipes-*/*/*.bb \
        ${LAYERDIR}/recipes-*/*/*.bbappend"

BBFILE_COLLECTIONS += "meta-amarula-solutions-demo-images"
BBFILE_PATTERN_meta-amarula-solutions-demo-images = "^${LAYERDIR}"
BBFILE_PRIORITY_meta-amarula-solutions-demo-images = "100"

# This should only be incremented on significant changes that will
# cause compatibility issues with other layers
LAYERVERSION_meta-amarula-solutions-demo-images = "1"

LAYERDEPENDS_meta-amarula-solutions-demo-images = " \
    core \
"

LAYERSERIES_COMPAT_meta-amarula-solutions-demo-images = "wrynose"
```

## meta-amarula-solutions-demo-images/meta-demoimages/conf/distro/demoimages.conf
```bitbake
DISTRO = "demoimages"
DISTRO_NAME = "demo images"
DISTRO_CODENAME = "wrynose"

# Bump this every time OpenEmbedded is updated!
DISTRO_VERSION = "1.0"
SDK_VENDOR = "-demoimagessdk"
SDK_VERSION := "${@'${DISTRO_VERSION}'.replace('snapshot-${METADATA_REVISION}','snapshot')}"
SDK_VERSION[vardepvalue] = "${SDK_VERSION}"

MAINTAINER = "Adam Duskett <adam.duskett@amarulasolutions.com>"

TARGET_VENDOR = "-demoimages"

REQUIRED_BBLAYERS_CONF_VERSION = "${DISTRO}-1"

LOCALCONF_VERSION = "2"

PACKAGE_CLASSES ?= "package_rpm"

SANITY_TESTED_DISTROS ?= " \
  fedora-42 \n \
  fedora-43 \n \
  fedora-44 \n \
  debian-11 \n \
  debian-12 \n \
  debian-13 \n \
"

# Set features we want. Also disables any features not explicitly mentioned.
DISTRO_FEATURES = " \
  ipv4 \
  ipv6 \
  zeroconf \
"

IMAGE_FSTYPES ?= "tar ext4 wic wic.zst wic.bmap"

QB_DEFAULT_FSTYPE = "wic"

require conf/distro/include/efi-secureboot.inc
require conf/distro/include/cve-extra-exclusions.inc
require conf/distro/include/lto.inc
require conf/distro/include/rust_security_flags.inc

INHERIT += "uninative"
```

## meta-amarula-solutions-demo-images/meta-demoimages/conf/distro/include/efi-secureboot.inc
```bitbake
DISTRO_FEATURES:remove = "efi"
DISTRO_FEATURES:append = " \
    efi-secure-boot \
    modsign \
"
INITRAMFS_IMAGE = "secure-core-image-initramfs"
EFI_PROVIDER = "grub-efi"
MACHINE_FEATURES_NATIVE:append = " efi"
MACHINE_FEATURES:append = " efi"

PACKAGE_CLASSES = "package_rpm"

GRUB_SIGN_VERIFY = "1"

UEFI_SB = "1"
UEFI_SELOADER = "0"
```

## meta-amarula-solutions-demo-images/meta-demoimages/conf/layer.conf
```bitbake
# We have a conf and classes directory, add to BBPATH
BBPATH .= ":${LAYERDIR}"

# We have recipes-* directories, add to BBFILES
BBFILES += "${LAYERDIR}/recipes-*/*/*.bb \
            ${LAYERDIR}/recipes-*/*/*.bbappend"

BBFILE_COLLECTIONS += "demoimages-layer"
BBFILE_PATTERN_demoimages-layer = "^${LAYERDIR}/"
BBFILE_PRIORITY_demoimages-layer = "9"

LAYERDEPENDS_demoimages-layer = "core"
LAYERSERIES_COMPAT_demoimages-layer = "wrynose"
```
